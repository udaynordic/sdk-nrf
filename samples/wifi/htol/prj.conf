## CMakeLists.txt
```
#
# Copyright (c) 2026 Nordic Semiconductor ASA
#
# SPDX-License-Identifier: LicenseRef-Nordic-5-Clause
#

cmake_minimum_required(VERSION 3.20.0)

find_package(Zephyr REQUIRED HINTS $ENV{ZEPHYR_BASE})
project(nrf_wifi_htol)

target_sources(app PRIVATE
	src/main.c
	src/wifi_subsys_bringup.c
)
```

## Kconfig
```
#
# Copyright (c) 2026 Nordic Semiconductor
#
# SPDX-License-Identifier: LicenseRef-Nordic-5-Clause
#

source "Kconfig.zephyr"

menu "nRF71 HTOL test sample"

config HTOL_HEARTBEAT_INTERVAL_S
	int "Heartbeat log interval (seconds)"
	default 10
	help
	  Interval for the idle heartbeat message while the sample waits for
	  host-to-LMAC patch test code to be added.

endmenu
```

## Kconfig.sysbuild
```
#
# Copyright (c) 2026 Nordic Semiconductor ASA
#
# SPDX-License-Identifier: LicenseRef-Nordic-5-Clause
#

source "${ZEPHYR_NRF_MODULE_DIR}/samples/wifi/Kconfig.sysbuild.nrf70"

source "share/sysbuild/Kconfig"
```

## sample.yaml
```
sample:
  description: Minimal nRF71 Wi-Fi ROM patch / HTOL test harness
  name: Wi-Fi HTOL
tests:
  sample.nrf7120.htol:
    sysbuild: true
    build_only: true
    integration_platforms:
      - nrf7120dk/nrf7120/cpuapp
      - nrf7120dk/nrf7120/cpuapp/ns
    platform_allow:
      - nrf7120dk/nrf7120/cpuapp
      - nrf7120dk/nrf7120/cpuapp/ns
      - nrf7120dk/nrf7120e/cpuapp
      - nrf7120dk/nrf7120e/cpuapp/ns
    tags:
      - ci_build
      - sysbuild
      - ci_samples_nrf71_wifi
```

## sysbuild.conf
```
#
# Copyright (c) 2026 Nordic Semiconductor ASA
#
# SPDX-License-Identifier: LicenseRef-Nordic-5-Clause
#
```

## prj.conf
```kconfig
#
# Copyright (c) 2026 Nordic Semiconductor ASA
#
# SPDX-License-Identifier: LicenseRef-Nordic-5-Clause
#

CONFIG_PRINTK=y
CONFIG_LOG=y
CONFIG_ASSERT=y
CONFIG_MAIN_STACK_SIZE=4096

# Wi-Fi LMAC start is triggered from the sample (htol_wifi_subsys_bringup).
# CONFIG_SOC_NRF71_WIFI_BOOT is not set
CONFIG_SOC_SERIES_NRF71_ANTSW_DEFAULT_WIFI=y

# No networking stack, Wi-Fi driver, or WPA supplicant in this sample (yet).
# CONFIG_NETWORKING is not set
# CONFIG_WIFI is not set
# CONFIG_WIFI_NRF71 is not set
```

## boards/nrf7120dk_nrf7120_cpuapp.conf
```kconfig
#
# Copyright (c) 2026 Nordic Semiconductor
#
# SPDX-License-Identifier: LicenseRef-Nordic-5-Clause
#
```

## socs/nrf7120_cpuapp_ns.conf
```kconfig
CONFIG_WIFI_NRF71_PATCH=y
```

## socs/nrf7120_cpuapp.overlay
```dts
/*
 * Copyright (c) 2026 Nordic Semiconductor ASA
 *
 * SPDX-License-Identifier: LicenseRef-Nordic-5-Clause
 */

#include <vendor/nordic/wifi/nrf7120_wifi_patch_0_1_0.dtsi>

/* Zephyr Wi-Fi driver is out of scope for this sample. */
&wifi {
	status = "disabled";
};
```

## socs/nrf7120e_cpuapp.overlay
```dts
#include "nrf7120_cpuapp.overlay"
```

## socs/nrf7120e_cpuapp_ns.overlay
```dts
#include "nrf7120_cpuapp_ns.overlay"
```

## src/main.c
```c
/*
 * Copyright (c) 2026 Nordic Semiconductor ASA
 *
 * SPDX-License-Identifier: LicenseRef-Nordic-5-Clause
 */

/** @file
 *  @brief Minimal nRF71 HTOL / Wi-Fi ROM patch test harness
 *
 *  Wi-Fi ROM patches are merged into the application image (see
 *  CONFIG_WIFI_NRF71_PATCH). The Zephyr nRF71 Wi-Fi driver and WPA
 *  supplicant are intentionally disabled; use this sample to exercise
 *  host-to-LMAC patch loading before pulling in the full Wi-Fi stack.
 */

#include <zephyr/kernel.h>
#include <zephyr/logging/log.h>

#include "wifi_subsys_bringup.h"

LOG_MODULE_REGISTER(htol, CONFIG_LOG_DEFAULT_LEVEL);

int main(void)
{
	int err;

	LOG_INF("nRF71 HTOL sample (ROM patches in image, no Wi-Fi driver)");

	err = htol_wifi_subsys_bringup();
	if (err != 0) {
		LOG_ERR("Bring-up failed (%d)", err);
		return err;
	}

	while (true) {
		k_sleep(K_SECONDS(CONFIG_HTOL_HEARTBEAT_INTERVAL_S));
		LOG_INF("Heartbeat — add HTOL patch test steps here");
	}

	return 0;
}
```

## src/wifi_subsys_bringup.c
```c
/*
 * Copyright (c) 2026 Nordic Semiconductor ASA
 *
 * SPDX-License-Identifier: LicenseRef-Nordic-5-Clause
 */

#include <errno.h>

#include <zephyr/autoconf.h>
#include <zephyr/devicetree.h>
#include <zephyr/logging/log.h>
#include <zephyr/sys/sys_io.h>

#include <nrfx.h>
#include <hal/nrf_gpio.h>
#include <hal/nrf_lrcconf.h>
#include <hal/nrf_vpr.h>
#include <soc.h>
#include <wicr_setup.h>

LOG_MODULE_DECLARE(htol, CONFIG_LOG_DEFAULT_LEVEL);

/* WIFISYS RPUSYS — same as nrf/drivers/wifi/nrf71/src/system/wifi_pm.c */
#define WIFICORE_RPUSYS_BASE            0x48080000UL
#define WIFI_AUTOCG_SET_ALL             (WIFICORE_RPUSYS_BASE + 0x1B014UL)
#define WIFI_AUTOCG_CLR_ALL             (WIFICORE_RPUSYS_BASE + 0x1B018UL)
#define WIFI_RF_CLOCK_CTRL_SET          (WIFICORE_RPUSYS_BASE + 0x1B024UL)
#define WIFI_RAM_ENABLE_SET_ALL         (WIFICORE_RPUSYS_BASE + 0x1B044UL)
#define WIFI_ENABLE_ALL_TRIGGER         1UL
#define WIFI_RF_CLOCK_INT_EXT           0x3UL
#define WIFI_SYSTEM_OFF_TOKEN           0x280002FCUL

#if DT_HAS_COMPAT_STATUS_OKAY(nordic_nrf71_antsw)
#define ANTSW_NODE DT_COMPAT_GET_ANY_STATUS_OKAY(nordic_nrf71_antsw)

BUILD_ASSERT(DT_HAS_COMPAT_STATUS_OKAY(nordic_nrf_pwr_antswc),
	     "antsw steering requires pwr_antswc to power the antenna switch");

static void antsw_setup(void)
{
	uint32_t sel_psel = NRF_DT_GPIOS_TO_PSEL(ANTSW_NODE, sel_gpios);

	if (IS_ENABLED(CONFIG_SOC_SERIES_NRF71_ANTSW_DEFAULT_BLE)) {
		nrf_gpio_pin_set(sel_psel);
	} else {
		nrf_gpio_pin_clear(sel_psel);
	}
	nrf_gpio_cfg_output(sel_psel);
}
#endif /* nordic_nrf71_antsw */

static void wifi_rpu_power_on(void)
{
	nrf_lrcconf_poweron_force_set(NRF_WIFICORE_LRCCONF_LRC0,
				      NRF_LRCCONF_POWER_MAIN, true);

	sys_write32(0, WIFI_SYSTEM_OFF_TOKEN);
	sys_write32(WIFI_ENABLE_ALL_TRIGGER, WIFI_AUTOCG_SET_ALL);
	sys_write32(WIFI_ENABLE_ALL_TRIGGER, WIFI_RAM_ENABLE_SET_ALL);
	sys_write32(WIFI_RF_CLOCK_INT_EXT, WIFI_RF_CLOCK_CTRL_SET);
	__DSB();
}

static void wifi_vpr_start(NRF_VPR_Type *vpr, uint32_t init_pc)
{
	nrf_vpr_initpc_set(vpr, init_pc);
	nrf_vpr_cpurun_set(vpr, true);
}

static void wifi_processors_start(void)
{
	/*
	 * Same sequence as soc.c wifi_setup() / nrf_wifi_power_on(), plus
	 * explicit UMAC VPR start from WICR UMACINITPC.
	 */
	wifi_rpu_power_on();

	wifi_vpr_start(NRF_WIFICORE_LMAC_VPR,
		       (uint32_t)(uintptr_t)NRF_WICR->FIRMWARE.LMACINITPC);
	wifi_vpr_start(NRF_WIFICORE_UMAC_VPR,
		       (uint32_t)(uintptr_t)NRF_WICR->FIRMWARE.UMACINITPC);
}

int htol_wifi_subsys_bringup(void)
{
	int err = 0;

	LOG_INF("Wi-Fi subsystem bring-up (no driver)");

#if defined(CONFIG_SOC_NRF7120_WICR_SETUP) && !defined(CONFIG_BUILD_WITH_TFM)
	err = wicr_setup();
	if (err != 0) {
		LOG_ERR("WICR setup failed: %d", err);
		return err;
	}
	LOG_INF("WICR programmed");
#elif defined(CONFIG_BUILD_WITH_TFM)
	LOG_DBG("WICR setup handled by TF-M secure firmware");
#endif

#if DT_HAS_COMPAT_STATUS_OKAY(nordic_nrf_pwr_antswc)
	*(volatile uint32_t *)PWR_ANTSWC_REG |= PWR_ANTSWC_ENABLE;
	LOG_DBG("Antenna switch powered");
#endif

#if DT_HAS_COMPAT_STATUS_OKAY(nordic_nrf71_antsw)
	antsw_setup();
	LOG_DBG("Antenna switch steered to default radio");
#endif

#if defined(NRF_APPLICATION)
	wifi_processors_start();
	LOG_INF("LMAC VPR @ %p, UMAC VPR @ %p",
		(void *)(uintptr_t)NRF_WICR->FIRMWARE.LMACINITPC,
		(void *)(uintptr_t)NRF_WICR->FIRMWARE.UMACINITPC);
#else
	LOG_ERR("Wi-Fi bring-up requires the application core");
	return -ENOTSUP;
#endif

	return err;
}
```

## src/wifi_subsys_bringup.h
```c
/*
 * Copyright (c) 2026 Nordic Semiconductor ASA
 *
 * SPDX-License-Identifier: LicenseRef-Nordic-5-Clause
 */

#ifndef WIFI_SUBSYS_BRINGUP_H__
#define WIFI_SUBSYS_BRINGUP_H__

/**
 * Bring up the nRF71 Wi-Fi hardware without the Zephyr Wi-Fi driver.
 *
 * Mirrors the Wi-Fi-related steps in @c nordicsemi_nrf71_init(): WICR
 * programming, antenna switch power/steering, RPU power/clock enable, and
 * LMAC/UMAC VPR start from WICR init PCs.
 * ROM LMAC/UMAC patch binaries are still merged via @kconfig{CONFIG_WIFI_NRF71_PATCH}.
 *
 * @return 0 on success, negative errno on failure.
 */
int htol_wifi_subsys_bringup(void);

#endif /* WIFI_SUBSYS_BRINGUP_H__ */
```
